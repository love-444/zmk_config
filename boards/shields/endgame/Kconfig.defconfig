## boards/shields/endgame/Kconfig.defconfig
```kconfig
config SHIELD_ENDGAME_DONGLE_DISPLAY_OLED
    bool "Enable 128*64 OLED widget for dongle"

if SHIELD_ENDGAME_DONGLE_DISPLAY_OLED

choice ZMK_DISPLAY_STATUS_SCREEN
    default ZMK_DISPLAY_STATUS_SCREEN_CUSTOM
endchoice

config ZMK_DISPLAY_STATUS_SCREEN_CUSTOM
    select LV_USE_LABEL
    select LV_USE_IMG
    select LV_USE_CANVAS
    select LV_USE_ANIMIMG 
    select LV_USE_ANIMATION
    select LV_USE_LINE 
    select LV_FONT_UNSCII_8
    select ZMK_WPM

choice ZMK_DISPLAY_WORK_QUEUE
    default ZMK_DISPLAY_WORK_QUEUE_DEDICATED
endchoice

config LV_Z_MEM_POOL_SIZE
    default 8192

config LV_Z_VDB_SIZE
    default 64

config LV_DPI_DEF
    default 148

config LV_Z_BITS_PER_PIXEL
    default 1

choice LV_COLOR_DEPTH
    default LV_COLOR_DEPTH_1
endchoice

endif 

if SHIELD_ENDGAME_TRACKBALL

config ZMK_KEYBOARD_NAME
	default "Endgame"

config ZMK_SPLIT_ROLE_CENTRAL
    default y
    
if ZMK_DISPLAY

config I2C
    default y

config SSD1306
    default y

endif # ZMK_DISPLAY

if LVGL

config LV_Z_VDB_SIZE
    default 64

config LV_DPI_DEF
    default 148

config LV_Z_BITS_PER_PIXEL
    default 1

choice LV_COLOR_DEPTH
    default LV_COLOR_DEPTH_1
endchoice

endif # LVGL

endif

if SHIELD_ENDGAME_TRACKBALL || SHIELD_ENDGAME_LEFT || SHIELD_ENDGAME_RIGHT

config ZMK_SPLIT
    default y
    
endif
```

## boards/shields/endgame/Kconfig.shield
```kconfig
config SHIELD_ENDGAME_LEFT
	def_bool $(shields_list_contains,endgame_left)

config SHIELD_ENDGAME_RIGHT
	def_bool $(shields_list_contains,endgame_right)

config SHIELD_ENDGAME_TRACKBALL
	def_bool $(shields_list_contains,endgame_trackball)

config SHIELD_DONGLE_DISPLAY_OLED
	def_bool $(shields_list_contains,dongle_display_oled)
```

## config/west.yml
```yaml
manifest:
  remotes:
    - name: zmkfirmware
      url-base: https://github.com/petejohanson
    - name: badjeff
      url-base: https://github.com/badjeff
    - name: englmaxi
      url-base: https://github.com/englmaxi
  projects:
    - name: zmk
      remote: zmkfirmware
      revision: feat/pointers-move-scroll
      import: app/west.yml
    - name: zmk-pmw3610-driver
      remote: badjeff
      revision: main
    - name: zmk-input-behavior-listener
      remote: badjeff
      revision: main
    - name: zmk-dongle-display
      remote: englmaxi
      revision: main
  self:
    path: config
```
